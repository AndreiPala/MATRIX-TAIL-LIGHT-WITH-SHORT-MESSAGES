
// C++ code
//
  byte Font[480]={
	0x00, 0x00, 0x00, 0x00, 0x00,// (space)
	0x00, 0x00, 0x5F, 0x00, 0x00,// !
	0x00, 0x07, 0x00, 0x07, 0x00,// "
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	0x08, 0x1C, 0x2A, 0x08, 0x08 // <-
};

int di1=2;
int di2=7;
int oe1=3;
int oe2=8;
int latch1=4;
int latch2=9;
int clk1=5;
int clk2=10;
int reset1=6;
int reset2=11;

bool mat[7][5]=
			   {{0,0,0,0,0},
                {0,0,0,0,0},
                {0,0,0,0,0},
                {0,0,0,0,0},
                {0,0,0,0,0},
                {0,0,0,0,0},
                {0,0,0,0,0}};

void setup()
{
  pinMode(di1, OUTPUT);
  pinMode(di2, OUTPUT);
  pinMode(oe1, OUTPUT);
  pinMode(oe2, OUTPUT);
  pinMode(latch1, OUTPUT);
  pinMode(latch2, OUTPUT);
  pinMode(clk1, OUTPUT);
  pinMode(clk2, OUTPUT);
  pinMode(reset1, OUTPUT);
  pinMode(reset2, OUTPUT);
  digitalWrite(oe1,LOW);
  digitalWrite(oe2,LOW);
  digitalWrite(reset1,HIGH);
  digitalWrite(reset2,HIGH);
  Serial.begin(9600);

}

void loop()
{
  
  rowGoinDown(mat);
  /*char a='a';
  printChar(a);*/
  
}
void pushB(int di, int clk,bool b)
{
	digitalWrite(clk, LOW);
  	digitalWrite(di,b);
  	digitalWrite(clk,HIGH);
}

void reset(int resett,int latch)
{
	digitalWrite(resett,LOW);
  	digitalWrite(latch,LOW);
  	digitalWrite(latch,HIGH);
  	digitalWrite(resett,HIGH);
}

void push(bool mat[7][5],int n,int m,unsigned long frametime)//n linii(7); m coloane(5)
{
  unsigned long startime=millis();
  while(millis()-startime<frametime)
  {
    //Serial.println(millis()-startime);
  	for(int i=0;i<m;++i)
    {
	  reset(reset1,latch1);
      reset(reset2,latch2);
      
  	  digitalWrite(latch1,LOW);
      digitalWrite(latch2,LOW);
      
  	  for(int k=0;k<n;++k)//linie
        pushB(di1,clk1,mat[k][i]);
      
      for(int j=0;j<m;++j)//coloana
        pushB(di2,clk2,i==j);
      
      digitalWrite(latch1,HIGH);
      digitalWrite(latch2,HIGH);
      delay(10);
      
    }
    
  }
  reset(reset1,latch1);
  reset(reset2,latch2);
  	
  	
}
void negare(bool mat[7][5])
{
	for(int i=0;i<7;++i)
      for(int j=0;j<5;++j)
      	mat[i][j]=!mat[i][j];
}
void rowGoinDown(bool mat[7][5])
{
	for(int i=0;i<7;++i)
    {
    	for(int j=0;j<7;++j)
          for(int k=0;k<5;++k)
          	mat[j][k]=i==j;
        push(mat,7,5,250);
    }
}


void printChar(char c)
{
	if(int(c)>127||int(c)<32)
      return;
  	else
    {
    	int c_a=int(c)-32;
      	for(int i=0;i<5;++i)
        {
        	reset(reset1,latch1);
      		reset(reset2,latch2);
      
  	  		digitalWrite(latch1,LOW);
      		digitalWrite(latch2,LOW);
          	
          	for(int j=0;j<7;++j)
            {
            	byte x=Font[c_a*5+j];
              	pushB(di1,clk1,x%2);
              	x=x>>1;
              	Serial.println();
            }
          	for(int k=0;k<5;++k)//coloana
        		pushB(di2,clk2,i==k);
          	digitalWrite(latch1,HIGH);
      		digitalWrite(latch2,HIGH);
          
          
        }
      	
    }
      
}

